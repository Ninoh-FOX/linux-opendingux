## Documentation/devicetree/bindings/display/panel/newvision,nv3052c.yaml
```yaml
# SPDX-License-Identifier: (GPL-2.0-only OR BSD-2-Clause)
%YAML 1.2
---
$id: http://devicetree.org/schemas/display/panel/newvision,nv3052c.yaml#
$schema: http://devicetree.org/meta-schemas/core.yaml#

title: NewVision NV3052C TFT LCD panel driver with SPI control bus

maintainers:
  - Paul Cercueil <paul@crapouillou.net>

description: |
  This is a IC driver for TFT panels, accepting a variety of input
  streams that get adapted and scaled to the panel.

  The panel must obey the rules for a SPI slave device as specified in
  spi/spi-controller.yaml

allOf:
  - $ref: panel-common.yaml#

properties:
  compatible:
    items:
      - enum:
          - leadtek,ltk035c5444t-spi

      - const: newvision,nv3052c

  reg:
    maxItems: 1

  reset-gpios: true
  power-supply: true
  backlight: true
  port: true

  vci-supply:
    description:
      Power supply for analog circuits (VCI=2.5V to 6V)

  vddam-supply:
    description:
      Power Supply for MIPI regulator circuits (VDDAM=1.75V to 6V)

  iovcc-supply:
    description: |
      External Power Supply for IO pads and other logic circuits
      (IOVCC=1.65 to 3.6V)

  pprech-supply:
    description:
      Pre-charge power for source (can be connected to IOVCC or VCI)

  vpp-supply:
    description:
      Input power for NV memory programming (8.0V ~ 8.5V, typical=8.25V)

required:
  - compatible
  - reg

oneOf:
  - required:
      - power-supply
  - required:
      - vci-supply
      - vddam-supply
      - iovcc-supply
      - pprech-supply
      - vpp-supply

unevaluatedProperties: false

examples:
  - |
    #include <dt-bindings/gpio/gpio.h>
    spi {
        #address-cells = <1>;
        #size-cells = <0>;

        display@0 {
            compatible = "leadtek,ltk035c5444t-spi", "newvision,nv3052c";
            reg = <0>;

            spi-max-frequency = <15000000>;
            spi-3wire;
            reset-gpios = <&gpe 2 GPIO_ACTIVE_LOW>;
            backlight = <&backlight>;
            power-supply = <&vcc>;

            port {
                panel_input: endpoint {
                    remote-endpoint = <&panel_output>;
                };
            };
        };
    };

...
```

## Documentation/devicetree/bindings/hwlock/ingenic,vpu-hwspinlock.yaml
```yaml
# SPDX-License-Identifier: (GPL-2.0-only OR BSD-2-Clause)
%YAML 1.2
---
$id: http://devicetree.org/schemas/hwlock/ingenic,vpu-hwspinlock.yaml#
$schema: http://devicetree.org/meta-schemas/core.yaml#

title: Ingenic VPU Hardware Spinlock

maintainers:
  - Paul Cercueil <paul@crapouillou.net>

description:
  The Hardware Spinlock of the VPU provides a mutex mechanism between the main
  processor and the co-processor present in the VPU IP.

properties:
  compatible:
    oneOf:
      - enum:
          - ingenic,jz4755-vpu-hwspinlock
      - items:
          - enum:
              - ingenic,jz4760-vpu-hwspinlock
              - ingenic,jz4770-vpu-hwspinlock
              - ingenic,jz4780-vpu-hwspinlock
          - const: ingenic,jz4755-vpu-hwspinlock

  reg:
    maxItems: 1

  '#hwlock-cells':
    const: 0

required:
  - compatible
  - reg
  - '#hwlock-cells'

additionalProperties: false

examples:
  - |
    hwspinlock: hwlock@4 {
      compatible = "ingenic,jz4755-vpu-hwspinlock";
      reg = <0x4 0xc>;
      #hwlock-cells = <0>;
    };
```

## Documentation/devicetree/bindings/mips/ingenic/devices.yaml
```yaml
# SPDX-License-Identifier: (GPL-2.0-only OR BSD-2-Clause)
%YAML 1.2
---
$id: http://devicetree.org/schemas/mips/ingenic/devices.yaml#
$schema: http://devicetree.org/meta-schemas/core.yaml#

title: Ingenic XBurst based Platforms Device Tree Bindings

maintainers:
  - 周琰杰 (Zhou Yanjie) <zhouyanjie@wanyeetech.com>

description:
  Devices with a Ingenic XBurst CPU shall have the following properties.

properties:
  $nodename:
    const: '/'
  compatible:
    oneOf:

      - description: Qi Hardware Ben NanoNote
        items:
          - const: qi,lb60
          - const: ingenic,jz4740

      - description: Wolsen LDK (horizontal)
        items:
          - const: wolsen,ldkh
          - const: ingenic,jz4760

      - description: Wolsen LDK (vertical)
        items:
          - const: wolsen,ldkv
          - const: ingenic,jz4760b

      - description: Wolsen PlayGo
        items:
          - const: wolsen,playgo
          - const: ingenic,jz4770

      - description: YLM RetroMini RS-90
        items:
          - const: ylm,rs90
          - const: ingenic,jz4725b

      - description: YLM RS-97
        items:
          - const: ylm,rs97
          - const: ingenic,jz4760

      - description: YLM RG-300
        items:
          - const: ylm,rg300
          - const: ingenic,jz4760b

      - description: YLM RG-99
        items:
          - const: ylm,rg99
          - const: ingenic,jz4725b

      - description: Game Consoles Worldwide GCW Zero
        items:
          - const: gcw,zero
          - const: ingenic,jz4770

      - description: YLM RG-350
        items:
          - const: ylm,rg350
          - const: ingenic,jz4770

      - description: YLM RG-350M
        items:
          - const: ylm,rg350m
          - const: ingenic,jz4770

      - description: YLM RG-280M
        items:
          - const: ylm,rg280m
          - const: ingenic,jz4770

      - description: YLM RG-280V
        items:
          - const: ylm,rg280v
          - const: ingenic,jz4770

      - description: MIPS Creator CI20
        items:
          - const: img,ci20
          - const: ingenic,jz4780

      - description: YSH & ATIL General Board, CU1000 Module with Neo Backplane
        items:
          - const: yna,cu1000-neo
          - const: ingenic,x1000e

      - description: YSH & ATIL General Board, CU1830 Module with Neo Backplane
        items:
          - const: yna,cu1830-neo
          - const: ingenic,x1830

      - description: YSH & ATIL General Board, CU2000 Module with Neo Backplane
        items:
          - const: yna,cu2000-neo
          - const: ingenic,x2000e

additionalProperties: true

...
```
